## ibtrs/Kconfig
```kconfig
config INFINIBAND_IBTRS
	tristate
	depends on INFINIBAND_ADDR_TRANS

config INFINIBAND_IBTRS_CLIENT
	tristate "InfiniBand IBTRS client"
	depends on INFINIBAND_ADDR_TRANS
	select INFINIBAND_IBTRS
	help
	  Support for the simplified data transfer over InfiniBand.
	  The IBTRS protocol is defined by the ProfitBricks GmbH.

config INFINIBAND_IBTRS_SERVER
	tristate "InfiniBand IBTRS server"
	depends on INFINIBAND_ADDR_TRANS
	select INFINIBAND_IBTRS
	help
	  Support for the simplified data transfer over InfiniBand.
	  The IBTRS protocol is defined by the ProfitBricks GmbH.
```

## rnbd/Kconfig
```kconfig
# SPDX-License-Identifier: GPL-2.0-or-later

config BLK_DEV_RNBD
	bool

config BLK_DEV_RNBD_CLIENT
	tristate "Network block device driver on top of RTRS transport"
	depends on INFINIBAND_RTRS_CLIENT
	select BLK_DEV_RNBD
	help
	  RNBD client allows for mapping of a remote block devices over
	  RTRS protocol from a target system where RNBD server is running.

	  If unsure, say N.

config BLK_DEV_RNBD_SERVER
	tristate "Network block device over RDMA Infiniband server support"
	depends on INFINIBAND_RTRS_SERVER
	select BLK_DEV_RNBD
	help
	  RNBD server allows for exporting local block devices to a remote client
	  over RTRS protocol.

	  If unsure, say N.
```

## rtrs/Kconfig
```kconfig
# SPDX-License-Identifier: GPL-2.0-or-later

config INFINIBAND_RTRS
	tristate
	depends on INFINIBAND_ADDR_TRANS

config INFINIBAND_RTRS_CLIENT
	tristate "RTRS client module"
	depends on INFINIBAND_ADDR_TRANS
	select INFINIBAND_RTRS
	help
	  RDMA transport client module.

	  RTRS client allows for simplified data transfer and connection
	  establishment over RDMA (InfiniBand, RoCE, iWarp). Uses BIO-like
	  READ/WRITE semantics and provides multipath capabilities.

config INFINIBAND_RTRS_SERVER
	tristate "RTRS server module"
	depends on INFINIBAND_ADDR_TRANS
	select INFINIBAND_RTRS
	help
	  RDMA transport server module.

	  RTRS server module processing connection and IO requests received
	  from the RTRS client module, it will pass the IO requests to its
	  user eg. RNBD_server.
```
